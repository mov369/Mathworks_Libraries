VERSION ""

NS_ :

BS_:

BU_: GCU_B

BO_ 276 GCU_B_Customer_Control_1: 8 GCU_B
 SG_ Steer_Request : 7|64@0- (1,0) [-100|100] "" Vector__XXX

BA_DEF_  "BusType" STRING ;
BA_DEF_DEF_  "BusType" "CAN";
