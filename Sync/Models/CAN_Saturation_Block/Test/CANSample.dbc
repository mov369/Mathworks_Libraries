VERSION ""

NS_ :

BS_:

BU_:

BO_ 16 CANMessage: 8 Vector__XXX
 SG_ CANSignal : 0|64@1- (1,0) [-1.7E+308|1.7E+308] "" Vector__XXX

BA_DEF_  "BusType" STRING ;
BA_DEF_DEF_  "BusType" "CAN";
SIG_VALTYPE_ 16 CANSignal : 2;
